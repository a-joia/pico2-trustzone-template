## CMakeLists.txt
```
cmake_minimum_required(VERSION 3.20.0)


# set(BOARD rpi_pico2)

find_package(Zephyr)
project(zephyr_app)

target_sources(app PRIVATE src/main.c)

#add compilation flags - define flag
target_compile_definitions(app PRIVATE
    -DPICO_RUNTIME_NO_INIT_PER_CORE_ENABLE_COPROCESSORS=1
)
```

## prj.conf
```kconfig
CONFIG_HAVE_CUSTOM_LINKER_SCRIPT=y
CONFIG_CUSTOM_LINKER_SCRIPT="nonsecure.ld"

CONFIG_TRUSTED_EXECUTION_NONSECURE=y
CONFIG_ARM_TRUSTZONE_M=y
```

## src/main.c
```c
int main(){

    while(1){}

}
```

## include/_rp2350.h
```c
#ifndef ____rp2350_h
#define ____rp2350_h


// Include core_cm33.h without error

#include "RP2350.h"
// #include "cmsis_compiler.h"
#include "core_cm33.h"


#endif
```
